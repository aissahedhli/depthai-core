## meta-icansii-distro/conf/distro/icansii.conf
```bitbake
DISTRO = "icansii"
DISTRO_NAME = "Icansii Reference Distribution"
DISTRO_VERSION = "1.0"
DISTRO_CODENAME = "kirkstone"

# ---------- Init System ----------
INIT_MANAGER = "systemd"
VIRTUAL-RUNTIME_init_manager = "systemd"
DISTRO_FEATURES:append = " systemd"

# ---------- Packaging ----------
PACKAGE_CLASSES ?= "package_ipk"
# autres options possibles:
# package_deb, package_rpm

# ---------- Libc ----------
TCLIBC ?= "glibc"

# ---------- Compiler / Security ----------
SECURITY_CFLAGS ?= "${DEBUG_CFLAGS}"
TARGET_CC_arch += "${SECURITY_CFLAGS}"

# ---------- GPLv3 filtering ----------
require conf/distro/include/no-gplv3.inc

# ---------- DISTRO Features ----------
DISTRO_FEATURES:append = " \
    acl \
    usbhost \
    wifi \
    bluetooth \
    ipv4 \
    ipv6 \
    xattr \
    zeroconf \
    vfat \
    ext2 \
    seccomp \
    usrmerge \
"

# ---------- DEFAULT PACKAGES ----------
IMAGE_INSTALL:append = " \
    python3 \
    python3-pip \
    python3-opencv \
    python3-pyserial \
    bluez5 \
    bluez5-testtools \
    oak-camera \
    lidar-ld19 \
"
```
